## main/Kconfig.projbuild
```kconfig
menu "Custom Configuration"
    config FW_VERSION
        string "FW Version"
        default "v0.0.0"
        help
            FW version.
    
    config PRODUCT_NAME
        string "PRODUCT_NAME"
        default "ESP32 Camera"
        help
            Product name.

    config DEBUG_INFORMATION_ENABLED
        bool "Debug information enabled"
        default n   
endmenu
```
